#include <behaviors.dtsi>
#include <dt-bindings/zmk/keys.h>
#include <dt-bindings/zmk/rgb.h>

&keymap {
    compatible = "zmk,keymap";

    default_layer {
        bindings = <
            &kp Q &kp W &kp E &kp R &kp T ... 
        >;
    };

    numbers_layer {
        bindings = <
            &kp N1 &kp N2 &kp N3 &kp N4 ...
        >;
    };

    navigation_layer {
        bindings = <
            &kp F1 &kp F2 &kp F3 &kp F4 ...
        >;
    };
};
