## config/west.yml
```yaml
manifest:
    remotes:
        - name: Lee-Seokjeong
          url-base: https://github.com/Lee-Seokjeong
        - name: Lee-Seokjeong
          url-base: https://github.com/Lee-Seokjeong
    projects:
        - name: zmk
          remote: Lee-Seokjeong
          revision: main
          import: app/west.yml
        # modules
        - name: zmk-pim447
          remote: Lee-Seokjeong
          revision: main
    self:
        path: config
```
